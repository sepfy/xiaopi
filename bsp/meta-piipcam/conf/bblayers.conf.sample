## bsp/meta-piipcam/conf/bblayers.conf.sample
```bitbake
# POKY_BBLAYERS_CONF_VERSION is increased each time build/conf/bblayers.conf
# changes incompatibly
POKY_BBLAYERS_CONF_VERSION = "2"

BBPATH = "${TOPDIR}"
BBFILES ?= ""

#BBLAYERS ?= " \
#  /mnt/piipcam/bsp/poky/meta \
#  /mnt/piipcam/bsp/poky/meta-poky \
#  /mnt/piipcam/bsp/poky/meta-yocto-bsp \
#  /mnt/piipcam/bsp/meta-openembedded/meta-oe \
#  /mnt/piipcam/bsp/meta-openembedded/meta-networking \
#  /mnt/piipcam/bsp/meta-openembedded/meta-python \
#  /mnt/piipcam/bsp/meta-openembedded/meta-filesystems \
#  /mnt/piipcam/bsp/meta-raspberrypi \
#  /mnt/piipcam/bsp/meta-piipcam \
#  "
```

## bsp/meta-xiaopi/conf/bblayers.conf.sample
```bitbake
# POKY_BBLAYERS_CONF_VERSION is increased each time build/conf/bblayers.conf
# changes incompatibly
POKY_BBLAYERS_CONF_VERSION = "2"

BBPATH = "${TOPDIR}"
BBFILES ?= ""

#BBLAYERS ?= " \
#  /mnt/xiaopi/bsp/poky/meta \
#  /mnt/xiaopi/bsp/poky/meta-poky \
#  /mnt/xiaopi/bsp/poky/meta-yocto-bsp \
#  /mnt/xiaopi/bsp/meta-openembedded/meta-oe \
#  /mnt/xiaopi/bsp/meta-openembedded/meta-networking \
#  /mnt/xiaopi/bsp/meta-openembedded/meta-python \
#  /mnt/xiaopi/bsp/meta-openembedded/meta-filesystems \
#  /mnt/xiaopi/bsp/meta-raspberrypi \
#  /mnt/xiaopi/bsp/meta-xiaopi \
#  "
```

## bsp/meta-xiaopi/conf/layer.conf
```bitbake
# We have a conf and classes directory, add to BBPATH
BBPATH .= ":${LAYERDIR}"

# We have recipes-* directories, add to BBFILES
BBFILES += "${LAYERDIR}/recipes-*/*/*.bb \
            ${LAYERDIR}/recipes-*/*/*.bbappend"

BBFILE_COLLECTIONS += "meta-edge"
BBFILE_PATTERN_meta-edge = "^${LAYERDIR}/"
BBFILE_PRIORITY_meta-edge = "6"

LAYERDEPENDS_meta-edge = "core"
LAYERSERIES_COMPAT_meta-edge = "warrior"
```
